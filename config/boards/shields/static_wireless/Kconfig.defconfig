## config/boards/shields/static_wireless/Kconfig.defconfig
```kconfig
if SHIELD_STATIC_WIRELESS

config ZMK_KEYBOARD_NAME
    default "Static Wireless"

if ZMK_DISPLAY

config I2C
    default y

config SSD1306
    default y

config SSD1306_REVERSE_MODE
    default y

endif # ZMK_DISPLAY

endif
```

## config/boards/shields/static_wireless/Kconfig.shield
```kconfig
config SHIELD_STATIC_WIRELESS
    def_bool $(shields_list_contains,static_wireless)
```
